## arch/arm64/configs/nomagisk_defconfig
```kconfig
# KernelSU Next
CONFIG_KPROBES=y
CONFIG_KPROBE_EVENTS=y
CONFIG_KSU_KPROBE_HOOKS=y
CONFIG_KSU=y

# -02 compile
CONFIG_CC_OPTIMIZE_FOR_SIZE_AGGRESSIVE=y
# CONFIG_CC_OPTIMIZE_FOR_PERFORMANCE is not set
# CONFIG_CC_OPTIMIZE_FOR_PERFORMANCE_O3 is not set
# CONFIG_CC_OPTIMIZE_FOR_SIZE is not set

# Vibrator
CONFIG_AW8697_HAPTIC=m
CONFIG_INPUT_FF_MEMLESS=y
# CONFIG_INPUT_MSM_VIBRATOR is not set
# CONFIG_INPUT_PM8XXX_VIBRATOR is not set
CONFIG_INPUT_QCOM_HV_HAPTICS=y
# CONFIG_INPUT_GPIO_VIBRA is not set
# CONFIG_INPUT_REGULATOR_HAPTIC is not set
# CONFIG_INPUT_PWM_VIBRA is not set
# CONFIG_INPUT_DRV260X_HAPTICS is not set
# CONFIG_INPUT_DRV2665_HAPTICS is not set
# CONFIG_INPUT_DRV2667_HAPTICS is not set
# CONFIG_LOGIRUMBLEPAD2_FF is not set
# CONFIG_USB_TRANCEVIBRATOR is not set
CONFIG_LEDS_QPNP_VIBRATOR_LDO=y

# FileSystems
CONFIG_EXT4_FS=y
CONFIG_EXT4_FS_POSIX_ACL=y
CONFIG_EXT4_FS_SECURITY=y
CONFIG_JBD2=y
CONFIG_FS_MBCACHE=y

CONFIG_F2FS_FS=y
CONFIG_F2FS_FS_SECURITY=y
CONFIG_F2FS_FS_ENCRYPTION=y
CONFIG_F2FS_FS_XATTR=y

CONFIG_FAT_FS=y
CONFIG_VFAT_FS=y
CONFIG_EXFAT_FS=y
CONFIG_FAT_DEFAULT_CODEPAGE=866
CONFIG_FAT_DEFAULT_IOCHARSET="utf8"

CONFIG_NTFS_FS=y
# CONFIG_NTFS_RW is not set

CONFIG_FUSE_FS=y

CONFIG_OVERLAY_FS=y

CONFIG_TMPFS=y
CONFIG_TMPFS_POSIX_ACL=y

CONFIG_EROFS_FS=y
CONFIG_EROFS_FS_XATTR=y

# Disable audit
CONFIG_AUDIT=n
CONFIG_AUDITSYSCALL=n

# Disable crash dump
CONFIG_CRASH_DUMP=n
```

## arch/arm64/configs/vanillaKernel-defconfig
```kconfig
### KernelSU Next
CONFIG_KPROBES=y
CONFIG_KPROBE_EVENTS=y
CONFIG_KSU_KPROBE_HOOKS=y
CONFIG_KSU=y

### -O2 compile
# CONFIG_CC_OPTIMIZE_FOR_SIZE_AGGRESSIVE is not set
CONFIG_CC_OPTIMIZE_FOR_PERFORMANCE=y
# CONFIG_CC_OPTIMIZE_FOR_PERFORMANCE_O3 is not set
# CONFIG_CC_OPTIMIZE_FOR_SIZE is not set

### Vibrator
CONFIG_AW8697_HAPTIC=m
CONFIG_INPUT_FF_MEMLESS=y
# CONFIG_INPUT_MSM_VIBRATOR is not set
# CONFIG_INPUT_PM8XXX_VIBRATOR is not set
CONFIG_INPUT_QCOM_HV_HAPTICS=y
# CONFIG_INPUT_GPIO_VIBRA is not set
# CONFIG_INPUT_REGULATOR_HAPTIC is not set
# CONFIG_INPUT_PWM_VIBRA is not set
# CONFIG_INPUT_DRV260X_HAPTICS is not set
# CONFIG_INPUT_DRV2665_HAPTICS is not set
# CONFIG_INPUT_DRV2667_HAPTICS is not set
# CONFIG_LOGIRUMBLEPAD2_FF is not set
# CONFIG_USB_TRANCEVIBRATOR is not set
CONFIG_LEDS_QPNP_VIBRATOR_LDO=y

### FileSystems
# Ext4
CONFIG_EXT4_FS=y
CONFIG_EXT4_FS_POSIX_ACL=y
CONFIG_EXT4_FS_SECURITY=y
CONFIG_JBD2=y
CONFIG_FS_MBCACHE=y

# F2FS
CONFIG_F2FS_FS=y
CONFIG_F2FS_FS_SECURITY=y
CONFIG_F2FS_FS_ENCRYPTION=y
CONFIG_F2FS_FS_XATTR=y

# FAT
CONFIG_FAT_FS=y
CONFIG_VFAT_FS=y
CONFIG_EXFAT_FS=y
CONFIG_FAT_DEFAULT_CODEPAGE=866
CONFIG_FAT_DEFAULT_IOCHARSET="utf8"

# NTFS
CONFIG_NTFS_FS=y
# CONFIG_NTFS_RW is not set

# FuseFS
CONFIG_FUSE_FS=y

# OverlayFS
CONFIG_OVERLAY_FS=y

# TMPFS
CONFIG_TMPFS=y
CONFIG_TMPFS_POSIX_ACL=y

# EROFS
CONFIG_EROFS_FS=y
CONFIG_EROFS_FS_XATTR=y

### Disable crash dump
CONFIG_CRASH_DUMP=n

### HARDENING
# Seccomp
CONFIG_HAVE_ARCH_SECCOMP=y
CONFIG_SECCOMP=y
CONFIG_SECCOMP_FILTER=y

# CFI
CONFIG_CFI_CLANG=y
CONFIG_CFI_CLANG_SHADOW=y

# Stack protection
CONFIG_STACKPROTECTOR_STRONG=y

# RWX protection
CONFIG_STRICT_KERNEL_RWX=y
CONFIG_HAVE_EFFICIENT_UNALIGNED_ACCESS=y

# ASLR
CONFIG_RANDOMIZE_BASE=y
CONFIG_RANDOMIZE_MEMORY=y
CONFIG_HAVE_ARCH_MMAP_RND_BITS=y
CONFIG_HAVE_ARCH_MMAP_RND_COMPAT_BITS=y

# Heap hardening
CONFIG_SLAB_FREELIST_RANDOM=y
CONFIG_SLAB_FREELIST_HARDENED=y
CONFIG_INIT_ON_ALLOC_DEFAULT_ON=y

# Restrict kernel log to privileged users (avoids leaking kernel pointers/KASLR)
CONFIG_SECURITY_DMESG_RESTRICT=y

# BPF
CONFIG_BPF_JIT=y
CONFIG_BPF_JIT_ALWAYS_ON=y

# Module security
CONFIG_MODULE_UNLOAD=y
```
